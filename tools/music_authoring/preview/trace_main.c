/*
 * Original-engine tick trace for the ATMlib v1 authoring example
 * (examples/music_authoring/basic).  Companion to
 * research/fx/footprint_baseline/trace/trace_main.c; same host substitution
 * approach, but it plays the score generated by tools/atm-music instead of a
 * checked-in fixture.
 *
 * The unmodified library sources (src/atm_synth.c plus the src/cmd_parse.c it
 * includes) run on the host.  Only the osc.c timer layer is replaced, exactly
 * reproducing the Timer3 ISR callback scheduling:
 *
 *   - base timer  = OSC_SAMPLERATE / OSC_ISR_PRESCALER_DIV = 2000 Hz
 *   - preset      = 2000 / rate - 1  (original floor quantization)
 *   - a callback fires when its down-counter wraps 0 -> 0xFF
 *
 * One CSV row per channel per completed music callback ("music tick", 1-based
 * like the footprint trace).  Columns expose the note trigger (inc/note) and
 * explicit gate muting (cvol=0) plus ch->vol / ch->mod.
 *
 * Usage: trace_main [music_ticks]
 */
#include <stdint.h>
#include <stdio.h>
#include <string.h>
#include <stdlib.h>

#include "atm_synth.c"   /* includes src/cmd_parse.c; library core, unmodified */
#include "score.h"       /* generated by tools/atm-music build */

/* ------------------------------------------------------------------ */
/* osc.c timer-layer substitution (same contract as the footprint trace). */

struct host_cb {
	uint8_t preset;
	uint8_t counter;
	osc_tick_callback cb;
	void *priv;
};

struct osc_params osc_params_array[OSC_CH_COUNT];
static struct host_cb host_cb[OSC_TICK_CALLBACK_COUNT];

void osc_setup(void)
{
	uint8_t i;
	memset(osc_params_array, 0, sizeof(osc_params_array));
	memset(host_cb, 0, sizeof(host_cb));
	for (i = 0; i < OSC_CH_COUNT; i++) {
		osc_params_array[i].mod = 0x7F;
	}
	osc_params_array[OSC_CH_THREE].phase_increment = 0x0001; /* seed LFSR */
}

void osc_set_tick_rate(const uint8_t callback_idx, const uint16_t rate_hz)
{
	uint16_t base = OSC_SAMPLERATE / OSC_ISR_PRESCALER_DIV; /* 2000 */
	host_cb[callback_idx].preset = (uint8_t)(base / rate_hz - 1);
}

void osc_set_tick_callback(const uint8_t callback_idx, const osc_tick_callback cb, const void *priv)
{
	host_cb[callback_idx].cb = cb;
	host_cb[callback_idx].priv = (void *)priv;
	if (cb) {
		host_cb[callback_idx].counter = 0; /* trigger callback ASAP */
	}
}

void osc_get_tick_callback(const uint8_t callback_idx, osc_tick_callback *cb, void **priv)
{
	if (cb) {
		*cb = host_cb[callback_idx].cb;
	}
	if (priv) {
		*priv = host_cb[callback_idx].priv;
	}
}

/* ------------------------------------------------------------------ */

static uint32_t g_music_ticks = 0;
static uint32_t g_limit = 512;

static void print_header(void)
{
	printf("tick,channel,tempo,inc,vol,note,delay,cvol,cmod,active\n");
}

static void record_tick(void)
{
	for (uint8_t c = 0; c < OSC_CH_COUNT; c++) {
		printf("%u,%u,%u,0x%04x,%u,%u,0x%04x,%u,%u,0x%02x\n",
			(unsigned)g_music_ticks,
			(unsigned)c,
			(unsigned)atmlib_state.tick_rate,
			(unsigned)osc_params_array[c].phase_increment,
			(unsigned)osc_params_array[c].vol,
			(unsigned)channels[c].note,
			(unsigned)channels[c].delay,
			(unsigned)channels[c].vol,
			(unsigned)channels[c].mod,
			(unsigned)atmlib_state.channel_active_mute);
	}
}

static void host_tick_handler(void)
{
	for (uint8_t n = 0; n < OSC_TICK_CALLBACK_COUNT; n++) {
		if (host_cb[n].counter != 255) {
			if (!host_cb[n].cb) {
				host_cb[n].counter = 255;
			}
			continue;
		}
		if (host_cb[n].cb) {
			host_cb[n].cb(n, host_cb[n].priv);
			if (n == 0) {
				g_music_ticks++;
				record_tick();
			}
		}
		host_cb[n].counter = host_cb[n].preset;
	}
}

static void base_event(void)
{
	int due = 0;
	for (uint8_t n = 0; n < OSC_TICK_CALLBACK_COUNT; n++) {
		host_cb[n].counter--;
		if (host_cb[n].counter == 0xFF) {
			due = 1;
		}
	}
	if (due) {
		host_tick_handler();
	}
}

int main(int argc, char **argv)
{
	if (argc > 1) {
		g_limit = (uint32_t)strtoul(argv[1], NULL, 10);
	}

	osc_setup();
	atm_synth_setup();
	atm_synth_play_score((const uint8_t *)&score);

	print_header();
	while (g_music_ticks < g_limit) {
		if (g_music_ticks > 0 && atm_synth_is_score_stopped()) {
			break;
		}
		base_event();
	}
	return 0;
}
